## arch/arm/mach-imx/imxrt/Kconfig
```kconfig
if ARCH_IMXRT

config IMXRT
	bool

config IMXRT1050
	bool
	select IMXRT

config SYS_SOC
	default "imxrt"

choice
	prompt "NXP i.MXRT board select"
	optional

config TARGET_IMXRT1050_EVK
	bool "Support imxrt1050 EVK board"
	select IMXRT1050
    select SUPPORT_SPL
	

config TARGET_IMXRT105X_ZPL
    bool "Support imxrt1052 ZPL board"
    select IMXRT1050

endchoice

source "board/freescale/imxrt1050-evk/Kconfig"
source "board/freescale/imxrt105x-zb/Kconfig"

endif
```

## board/freescale/imxrt105x-zb/Kconfig
```kconfig
if TARGET_IMXRT105X_ZPL

config SYS_BOARD
	string
	default "imxrt105x-zb"

config SYS_VENDOR
	string
	default "freescale"

config SYS_SOC
	string
	default "imxrt1050"

config SYS_CONFIG_NAME
	string
	default "imxrt105x-zb"

config IMX_CONFIG
	default "board/freescale/imxrt105x-zb/imximage.cfg"

endif
```

## configs/imxrt105x-zb_defconfig
```kconfig
CONFIG_ARM=y
CONFIG_ARCH_IMXRT=y
CONFIG_SYS_TEXT_BASE=0x80001000
CONFIG_SYS_MALLOC_F_LEN=0x8000
CONFIG_DM_GPIO=y
CONFIG_TARGET_IMXRT105X_ZPL=y
CONFIG_NR_DRAM_BANKS=1
CONFIG_DISTRO_DEFAULTS=y
# CONFIG_USE_BOOTCOMMAND is not set
# CONFIG_DISPLAY_CPUINFO is not set
CONFIG_BOARD_EARLY_INIT_F=y
# CONFIG_CMD_BOOTD is not set
# CONFIG_BOOTM_NETBSD is not set
# CONFIG_BOOTM_PLAN9 is not set
# CONFIG_BOOTM_RTEMS is not set
# CONFIG_BOOTM_VXWORKS is not set
# CONFIG_CMD_ELF is not set
# CONFIG_CMD_GO is not set
# CONFIG_CMD_XIMG is not set
# CONFIG_CMD_EXPORTENV is not set
# CONFIG_CMD_IMPORTENV is not set
# CONFIG_CMD_LOADS is not set
# CONFIG_CMD_NAND is not set
CONFIG_CMD_SDRAM=y
# CONFIG_CMD_BLOCK_CACHE is not set
# CONFIG_CMD_MISC is not set
# CONFIG_PARTITIONS is not set
CONFIG_OF_CONTROL=y
CONFIG_DEFAULT_DEVICE_TREE="imxrt105x-zb"
CONFIG_SYS_RELOC_GD_ENV_ADDR=y
CONFIG_ENV_VARS_UBOOT_RUNTIME_CONFIG=y
# CONFIG_NET is not set
# CONFIG_OF_TRANSLATE is not set
CONFIG_BLK=y
CONFIG_HAVE_BLOCK_DEVICE=y
CONFIG_CLK_COMPOSITE_CCF=y
CONFIG_CLK_IMXRT1050=y
CONFIG_MXC_GPIO=y
# CONFIG_INPUT is not set
# CONFIG_MMC is not set
CONFIG_MTD=y
CONFIG_DM_MTD=y
CONFIG_MTD_RAW_NAND=y
CONFIG_SYS_NAND_USE_FLASH_BBT=y
CONFIG_NAND_IMXRT=y
CONFIG_MTD_UBI=y
CONFIG_PINCTRL=y
CONFIG_PINCTRL_IMXRT=y
CONFIG_RAM=y
CONFIG_IMXRT_SDRAM=y
CONFIG_FSL_LPUART=y
CONFIG_TIMER=y
CONFIG_REGEX=y
CONFIG_SHA1=y
CONFIG_SHA256=y
CONFIG_HEXDUMP=y
```
